## config/west.yml
```yaml
manifest:
  remotes:
    - name: zmkfirmware
      url-base: https://github.com/zmkfirmware
    - name: prospector
      url-base: https://github.com/t-ogura
    - name: sekigon-gonnoc
      url-base: https://github.com/sekigon-gonnoc
  projects:
    - name: zmk
      remote: zmkfirmware
      revision: main
      import: app/west.yml
    - name: prospector-zmk-module
      remote: prospector
      revision: v2.2b
      path: modules/prospector-zmk-module
    - name: zmk-feature-cdc-acm-bootloader-trigger
      remote: sekigon-gonnoc
      revision: main
      path: modules/zmk-feature-cdc-acm-bootloader-trigger
  self:
    path: config
```
